## CMakeLists.txt
```
#
# Copyright (c) 2018 Nordic Semiconductor
#
# SPDX-License-Identifier: LicenseRef-Nordic-5-Clause
#
cmake_minimum_required(VERSION 3.20.0)

find_package(Zephyr REQUIRED HINTS $ENV{ZEPHYR_BASE})
project(eink_tag)

# Build timestamp, taken here rather than passed in.
#
# It used to come from the Makefile as -DAPP_BUILD_YEAR=... after `--`, but
# every -D there goes to the SYSBUILD cache and never reaches this image, so
# the block below was simply never entered: SYSINFO printed no build= field
# (the web showed "Сборка —") and system_time_init() fell back to
# __DATE__/__TIME__, which is per translation unit and only right on a
# pristine build. Reading the clock here removes the plumbing and the trap
# both — CMake re-runs on every pristine build, which is what `make build`
# does. A value passed in still wins, so the old override keeps working.
if(NOT DEFINED APP_BUILD_YEAR)
  string(TIMESTAMP APP_BUILD_YEAR  "%Y")
  string(TIMESTAMP APP_BUILD_MONTH "%m")
  string(TIMESTAMP APP_BUILD_DAY   "%d")
  string(TIMESTAMP APP_BUILD_HOUR  "%H")
  string(TIMESTAMP APP_BUILD_MIN   "%M")
  string(TIMESTAMP APP_BUILD_SEC   "%S")
  # Strip leading zeros: 08 and 09 are invalid octal literals in C.
  foreach(part APP_BUILD_MONTH APP_BUILD_DAY APP_BUILD_HOUR APP_BUILD_MIN APP_BUILD_SEC)
    math(EXPR ${part} "${${part}} + 0" OUTPUT_FORMAT DECIMAL)
  endforeach()
endif()

zephyr_compile_definitions(
  APP_BUILD_YEAR=${APP_BUILD_YEAR}
  APP_BUILD_MONTH=${APP_BUILD_MONTH}
  APP_BUILD_DAY=${APP_BUILD_DAY}
  APP_BUILD_HOUR=${APP_BUILD_HOUR}
  APP_BUILD_MIN=${APP_BUILD_MIN}
  APP_BUILD_SEC=${APP_BUILD_SEC}
)
message(STATUS "Build time: ${APP_BUILD_YEAR}-${APP_BUILD_MONTH}-${APP_BUILD_DAY} ${APP_BUILD_HOUR}:${APP_BUILD_MIN}:${APP_BUILD_SEC}")

# Portable display library (lib/) — no Zephyr dependency except the port file.
# See lib/README.md for reusing it outside this project.
target_sources(app PRIVATE
  lib/eink/ssd1675a.c
  lib/eink/eink_lut.c
  lib/eink/port/ssd1675a_port_zephyr_nrf.c
  lib/gfx/graphics.c
  lib/gfx/dither.c
  lib/gfx/life.c
)

# Application
target_sources(app PRIVATE
  src/main.c
  src/app/battery.c
  src/app/display_manager.c
  src/app/display_screens.c
  src/app/commands.c
  src/app/system_time.c
  src/app/persist.c
  src/app/factory.c
  src/app/secauth.c
  src/app/mesh.c
  src/app/mesh_pdu.c
  src/app/power_profile.c
  src/ble/ble_service.c
)

zephyr_include_directories(src lib)

# The image is built -Os (CONFIG_SIZE_OPTIMIZATIONS) from when flash was the
# binding constraint. It is not any more — ~32 KB spare there against ~96% of
# RAM used — so the two files that dominate per-frame CPU are worth building
# for speed. Costs a little flash, nothing in RAM.
#
# Deliberately NOT applied to lib/eink/port/ssd1675a_port_zephyr_nrf.c: its
# 9-bit bit-bang meets the panel's setup/hold with counted __NOP()s measured
# under -Os, and re-timing that needs a scope on real hardware, not a guess.
set_source_files_properties(
  lib/gfx/graphics.c
  lib/gfx/dither.c
  PROPERTIES COMPILE_OPTIONS "-O2")

# Frame-buffer arena, sized for the largest panel this image can drive: a
# 400x300 B/W plane is 15000 B; the 128x296 B/W/R default uses 9472 B of it.
# display_manager picks the layout at boot from the panel probe.
#
# Now a Kconfig value (CONFIG_EINK_FRAME_ARENA_BYTES) rather than a literal:
# an image built for a fleet with no 400x300 panels can set it to 9472 and get
# 5528 bytes of RAM back — on this build that is several times the remaining
# headroom. It has to go through Kconfig because a -D passed after `--` lands
# in the sysbuild cache, not in the application image.
target_compile_definitions(app PRIVATE
  GRAPHICS_ARENA_BYTES=${CONFIG_EINK_FRAME_ARENA_BYTES})
```

## Kconfig
```
#
# Copyright (c) 2018 Nordic Semiconductor
#
# SPDX-License-Identifier: LicenseRef-Nordic-5-Clause
#

source "Kconfig.zephyr"

menu "E-ink tag firmware"

config BT_NUS_SECURITY_ENABLED
	bool "Require link-layer security on the NUS characteristics"
	default n
	select BT_SMP
	help
	  Gate the Nordic UART Service behind BLE pairing. Off by default:
	  SMP plus P-256 ECDH costs roughly 31 KB of flash and 6.4 KB of RAM,
	  which the mesh scanner needs, and access is already gated by the
	  app-level challenge-response in src/app/secauth.c.

config EINK_FRAME_ARENA_BYTES
	int "Frame-buffer arena size, bytes"
	default 15000
	help
	  Static .bss arena that display_manager carves the frame planes out of
	  at boot, sized for the largest panel this image can drive.

	    15000 - 400x300 B/W, one plane. Also covers the 128x296 B/W/R pair
	            (2 x 4736 = 9472), so a single image drives both panels.
	     9472 - 128x296 B/W/R only. Frees 5528 bytes of RAM, several times
	            the headroom this build otherwise has.

	  The cost of shrinking it is not a crash: graphics_init_panel() refuses
	  a layout that does not fit and detect_panel() falls back to 128x296, so
	  a 400x300 panel would be driven as if it were the small one - a wrong
	  picture. Only shrink this for a fleet you know has no 400x300 panels,
	  and build the large panel its own image.

config SETTINGS
	default y

config ZMS
	default y if (SOC_FLASH_NRF_RRAM || SOC_FLASH_NRF_MRAM)

config NVS
	default y if !(SOC_FLASH_NRF_RRAM || SOC_FLASH_NRF_MRAM)

endmenu
```

## prj.conf
```kconfig
#
# Copyright (c) 2018 Nordic Semiconductor
#
# SPDX-License-Identifier: LicenseRef-Nordic-5-Clause
#

# The upstream sample bridged UART to BLE; this firmware has no UART path at
# all — commands arrive over NUS and diagnostics go back the same way. No
# serial driver, no console.
CONFIG_SERIAL=n
CONFIG_CONSOLE=n
CONFIG_UART_CONSOLE=n

# Bit-banged 9-bit SPI to the panel needs plain GPIOs, not a SPI peripheral.
CONFIG_GPIO=y

CONFIG_HEAP_MEM_POOL_SIZE=1024

CONFIG_BT=y
CONFIG_BT_PERIPHERAL=y
CONFIG_BT_DEVICE_NAME="nrf52-E-ink-clock"
CONFIG_BT_DEVICE_NAME_DYNAMIC=y
CONFIG_BT_DEVICE_NAME_MAX=25
CONFIG_BT_DEVICE_APPEARANCE=833
CONFIG_BT_MAX_CONN=1
CONFIG_BT_MAX_PAIRED=1

# Enable the NUS service
CONFIG_BT_NUS=y

# ATT MTU 498: lets one vstream DRLE frame (~1.5KB) travel in 3 ATT writes
# instead of 7 — macOS paces write-without-response per ATT operation, so
# fewer/bigger writes = higher downlink throughput. L2CAP reassembles from
# 251-byte link-layer fragments (DLE); RX buffers must fit MTU+4.
CONFIG_BT_L2CAP_TX_MTU=498
CONFIG_BT_BUF_ACL_TX_SIZE=251
CONFIG_BT_BUF_ACL_RX_SIZE=502
CONFIG_BT_CTLR_DATA_LENGTH_MAX=251

# 2M PHY: doubles raw throughput for VSTREAM (peripheral requests it on connect)
CONFIG_BT_CTLR_PHY_2M=y
CONFIG_BT_USER_PHY_UPDATE=y

# --- Phase 1: connectionless flood-mesh between tags ---
# Observer = scan for mesh beacons. TX uses the existing LEGACY adv instance,
# time-shared: briefly switch it to a non-connectable mesh beacon, then restore
# the connectable NUS adv. (Ext adv would cost ~44 KB flash — over budget.)
CONFIG_BT_OBSERVER=y

# Extra ACL RX buffers: vstream pipelining queues several frames in flight
# while the RX thread blocks in ssd1675a_wait_busy() (~64 ms per frame).
# Reduced from 5 to 3 to fit with MCUboot.
CONFIG_BT_BUF_ACL_RX_COUNT_EXTRA=3

# BLE pairing / LE Secure Connections DISABLED. SMP+ECC (P-256 ECDH) pulls
# mbedtls/PSA/oberon into the app image (~31 KB flash, ~6.4 KB RAM) — exactly the
# room the connectionless mesh scanner (CONFIG_BT_OBSERVER) needs. The security
# model is app-level secauth (challenge-response, bt_encrypt_be) + the MCUboot
# signing key + per-message CMAC on mesh PDUs — link-layer pairing added nothing
# those don't already cover for this fleet (shelf prices are public data).
CONFIG_BT_SMP=n
CONFIG_BT_NUS_SECURITY_ENABLED=n
CONFIG_BT_BONDABLE=n

# Settings/NVS still needed (secauth key, custom name, persisted stats).
CONFIG_BT_SETTINGS=y
# Persistent stats (src/app/persist.c): settings_save_one() for the low-battery
# flash backstop. Pulled in by BT_SETTINGS already; kept explicit for clarity.
CONFIG_SETTINGS=y
CONFIG_FLASH=y
CONFIG_FLASH_PAGE_LAYOUT=y
CONFIG_FLASH_MAP=y

# Enable DK LED and Buttons library
CONFIG_DK_LIBRARY=y

CONFIG_SYSTEM_WORKQUEUE_STACK_SIZE=1280
# Logging disabled entirely. Every backend was already off (no console, no RTT,
# no UART backend), so LOG strings + per-module const source descriptors had no
# output path at all — pure waste. Dropping CONFIG_LOG saves ~20.5 KB flash
# (~13.8 KB of it in .data source descriptors registered by the BLE host).
# Debug output is via ble_printf() over NUS, not the logging subsystem.
CONFIG_LOG=n
CONFIG_USE_SEGGER_RTT=n

CONFIG_ASSERT=n
CONFIG_FPU=y
CONFIG_ADC=y
CONFIG_REBOOT=y
CONFIG_POWEROFF=y

# --- OTA DFU via BLE (mcumgr / SMP) ---
CONFIG_NCS_SAMPLE_MCUMGR_BT_OTA_DFU=y
CONFIG_MCUMGR_TRANSPORT_BT_REASSEMBLY=y
# Text commands no longer execute on the BLE host RX thread (they have their
# own thread in commands.c), so it only needs room for the host itself.
CONFIG_BT_RX_STACK_SIZE=1280
# A fatal fault (a stack-guard overflow, a bad access) must REBOOT, not halt.
# Halting leaves the tag dark until someone pulls the battery — and if the
# fault recurs on boot, even that does not help. With this, a fault reboots in
# ~1 s, the boot burst re-advertises, and the late image-confirm (main.c) means
# a genuinely bad image reverts to the last good one instead of looping. This
# is what makes "any command in any order cannot take the tag off the air"
# actually hold, rather than depending on every handler being perfectly sized.
CONFIG_RESET_ON_FATAL_ERROR=y
CONFIG_MCUMGR_GRP_IMG_UPLOAD_CHECK_HOOK=n
# DFU status events (started / chunk / stopped / pending) drive the command
# dispatcher's "busy with an update" window — see commands.c dfu_mgmt_cb.
CONFIG_MCUMGR_MGMT_NOTIFICATION_HOOKS=y
CONFIG_MCUMGR_GRP_IMG_STATUS_HOOKS=y
# Do NOT shrink below ~512: the "image list" RESPONSE with two slots is
# ~260 B incl. SMP header. With 256 the device answers rc=8 (EMSGSIZE),
# the host sees "no image in slot 1" and the update is never applied.
CONFIG_MCUMGR_TRANSPORT_NETBUF_SIZE=1024
CONFIG_SIZE_OPTIMIZATIONS=y

# Trim MCUmgr: keep only img_mgmt, disable OS and basic groups
CONFIG_MCUMGR_GRP_OS=n
CONFIG_MCUMGR_GRP_ZBASIC=n
CONFIG_MCUMGR_GRP_ZBASIC_STORAGE_ERASE=n

# Use integer-only printf to save ~1.5KB flash
CONFIG_CBPRINTF_NANO=y

# Link-Time Optimization: cross-module inlining + dead-code elimination.
# Biggest single flash lever here; needed to keep OTA images under the
# swap-using-move 56-sector ceiling with room to spare.
# LTO requires per-IRQ-local ISR table declaration (else Kconfig drops LTO).
CONFIG_ISR_TABLES_LOCAL_DECLARATION=y
CONFIG_LTO=y
```

## boards/nrf52dk_nrf52832.overlay
```dts
/*
 * Reserve the top 256 bytes of SRAM for retained statistics that must survive
 * an OTA DFU (warm reboot). See src/app/persist.c.
 *
 * sram0 is shrunk from 64K to 0xFF00 so the application linker never allocates
 * into the top region; the matching overlay in
 * sysbuild/mcuboot/boards/nrf52dk_nrf52832.overlay shrinks sram0 for MCUboot
 * too, so the bootloader's stack cannot clobber it between resets.
 */

&sram0 {
	reg = <0x20000000 0xFF00>;
};

/ {
	sram_retained: memory@2000ff00 {
		compatible = "mmio-sram";
		reg = <0x2000ff00 0x100>;
		status = "okay";
	};
};
```

## src/main.c
```c
/*
 * Application entry point: brings the modules up in dependency order,
 * then parks the main thread — all work happens in BLE callbacks, the
 * display thread and the system work queue.
 */

#include <zephyr/kernel.h>
#include <zephyr/logging/log.h>
#include <zephyr/drivers/gpio.h>
#include <zephyr/settings/settings.h>
#ifdef CONFIG_MCUBOOT_IMG_MANAGER
#include <zephyr/dfu/mcuboot.h>
#endif
#include "app/display_manager.h"
#include "app/battery.h"
#include "app/commands.h"
#include "app/system_time.h"
#include "app/persist.h"
#include "app/power_profile.h"
#include "app/secauth.h"
#include "app/mesh.h"
#include "ble/ble_service.h"
#include <gfx/graphics.h>
#include <dk_buttons_and_leds.h>

LOG_MODULE_REGISTER(main, LOG_LEVEL_INF);

#ifdef CONFIG_MCUBOOT_IMG_MANAGER
static void confirm_handler(struct k_work *work)
{
    ARG_UNUSED(work);
    if (!boot_is_img_confirmed()) {
        int rc = boot_write_img_confirmed();
        if (rc) {
            LOG_ERR("OTA confirm failed: %d", rc);
        } else {
            LOG_INF("OTA image confirmed");
        }
    }
}
static K_WORK_DELAYABLE_DEFINE(confirm_work, confirm_handler);
#endif

int main(void)
{
    LOG_INF("Starting Application...");

#ifdef CONFIG_MCUBOOT_IMG_MANAGER
    /* Confirm the running image only once it has demonstrably run: 15 s in,
     * from the system work queue. Confirming in the first line of main() made
     * a crashing image permanent — the reset it caused booted the same image
     * again, forever, and the only way back was a wire. Unconfirmed, a reset
     * within this window makes MCUboot swap the previous image back in, and
     * the tag comes back on the firmware that worked. Init here takes well
     * under two seconds, so a healthy image always gets confirmed; the one
     * cost is a power cycle inside the first 15 s of a new image, which
     * simply means updating again. */
    k_work_schedule(&confirm_work, K_SECONDS(15));
#endif

    // 1. Init Base Peripherals
    dk_leds_init();     // ble_service drives the LEDs via dk_set_led_*
    int batt_rc = battery_init();
    if (batt_rc) {
        LOG_ERR("Battery ADC init failed: %d — voltage reads will fail", batt_rc);
    }
    system_time_init(); // Set time from Build Date/Time
    persist_init();     // Validate retained-RAM stats (survives DFU reboot)


    // 2. Init Graphics & Display
    graphics_init();
    display_manager_init();

    // 3. Init commands module (watchdog work item, etc.)
    commands_init();

    // 4. Init BLE with Command Processor
    int err = ble_service_init(commands_process);
    if (err) {
        /* Do not bail out: the panel, the clock and the persisted statistics
         * work without BLE, and returning here would skip the settings load
         * and persist_post_settings() below — the boot would go uncounted and
         * the saved clock unadopted, while the display thread kept running. */
        LOG_ERR("BLE Init failed: %d — continuing without BLE", err);
        if (IS_ENABLED(CONFIG_SETTINGS)) {
            /* subsys_init first: ble_service_init() failed at bt_enable(),
             * before it got to its own settings_load(), so no backend is
             * registered yet and a bare settings_load() would silently load
             * nothing. Both calls are idempotent. */
            settings_subsys_init();
            settings_load();
        }
        secauth_init();   /* resolve the key even with no radio, so SYSINFO
                           * does not report against an all-zero key */
    } else {
        // Settings are now loaded (ble_service_init -> settings_load). Resolve
        // the effective auth key: NVS override > factory_data > compiled default.
        secauth_init();

        // Connectionless flood-mesh: needs the resolved node id
        // (ble_service_init) and the effective key (secauth_init) for PDU
        // signing. Starts scanning + the dispatch thread. Both need a live BT
        // stack, so this is the one step BLE failure has to skip.
        mesh_init();
    }

    // Settings are now loaded (ble_service_init -> settings_load): finalize
    // stats — restore from flash if RAM was lost, adopt saved clock, count boot.
    persist_post_settings();

    /* After the restore above, so the adopted total is not overwritten by it. */
    display_manager_recalibrate_energy();

    /* The persisted sleep profile is loaded now too: push its advertising
     * interval into the radio (the display thread reads the rest itself). */
    power_profile_apply();

    // 5. Draw the first screen; the display thread takes over from here —
    //    unless the stored display mode says this tag is showing a picture, in
    //    which case we draw nothing at all. The panel is bistable, so the image
    //    is still on it: after a reboot, and after a battery change years from
    //    now, the picture comes back by itself and nobody has to re-send it.
    if (power_display_saver_get()) {
        display_manager_update_status();
    } else {
        display_manager_boot_into_picture();
    }

    LOG_INF("System initialized");

    /* Everything from here runs in the display thread, the BLE callbacks and
     * the mesh dispatch thread. Park this one rather than returning, so its
     * stack stays available to whatever main() called into. */
    while (1) {
        k_sleep(K_FOREVER);
    }
    return 0;
}
```
